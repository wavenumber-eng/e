## CMakeLists.txt
```
cmake_minimum_required(VERSION 3.13.1)

find_package(Zephyr REQUIRED HINTS $ENV{ZEPHYR_BASE})


project(tick_test VERSION 1.0.0)


target_include_directories(app PRIVATE 
                          ${CMAKE_SOURCE_DIR}/src
                          )

target_sources(app PRIVATE 

   src/main.c 

)
```

## prj.conf
```kconfig
# CONFIG_SHELL=n
# CONFIG_SERIAL=y
# CONFIG_CONSOLE=y

# CONFIG_SHELL_BACKEND_SERIAL=y
# CONFIG_STDOUT_CONSOLE=y
# CONFIG_SHELL_PROMPT_UART=""
# CONFIG_UART_CONSOLE=y

# #CONFIG_RTT_CONSOLE=y
# #CONFIG_USE_SEGGER_RTT=y

# CONFIG_LOG=y
# CONFIG_LOG_BUFFER_SIZE=4096
# CONFIG_PRINTK=y


# CONFIG_MAIN_STACK_SIZE=8192
# CONFIG_SYSTEM_WORKQUEUE_STACK_SIZE=8192
# CONFIG_ISR_STACK_SIZE=8192
# CONFIG_USB_WORKQUEUE_STACK_SIZE=8192

# #CONFIG_NO_OPTIMIZATIONS=y


CONFIG_E=y
CONFIG_E_TICK_THREAD_STACK_SIZE=4096
CONFIG_E_BQ_MAX_PRINTF_LEN=256
```

## src/main.c
```c
#include <stdlib.h>
#include <string.h>
#include <zephyr/kernel.h>
#include "e.h"
#include <zephyr/logging/log.h>

LOG_MODULE_REGISTER(main);

#define TEST_LOG    printk

volatile uint32_t test_tick;

volatile int32_t count=0;


int main(void)
{
    
    //init is called int he zephyr e thread.

    while (1)
    {
        if(e_tick__timeout(&test_tick, 1000))
        {
                printk("hello %d\r\n",count++);
        }
        
        k_sleep(K_MSEC(10));
    }
}
```
