## lib/Kconfig
```kconfig
# Copyright (c) 2021 Legrand North America, LLC.
# SPDX-License-Identifier: Apache-2.0

menu "e"

config E
	bool "Enable E"


config _E_BQ_MAX_PRINTF_LEN
	int "Maximum BQ printf length"
	depends on E
	default 128
	range 32 1024
	help
	  Maximum length for BQ printf operations. This value determines
	  the buffer size allocated for formatted output operations.  This buffer is placed on the stack
endmenu
```

## lib/zephyr/Kconfig
```kconfig
# Copyright (c) 2021 Legrand North America, LLC.
# SPDX-License-Identifier: Apache-2.0

menu "e"

config E
	bool "Enable E for embedded"

config E_VT100_ENABLE
	default n
	bool "Enables VT100 macro expansions for shell colors, etc"


config E_BQ_MAX_PRINTF_LEN
	int "Maximum BQ printf length"
	depends on E
	default 128
	range 32 1024
	help
	  Maximum length for BQ printf operations. This value determines
	  the buffer size allocated for formatted output operations.  This buffer is placed on the stack

config E_TICK_THREAD_STACK_SIZE
	int "stack size of the e tick thread"
	depends on E
	default 2048
	range 512 65536
	help
		stack size of the e tick thread

config E_LOG_ENABLE
	bool "enable e logging"
	default n
	depends on E
	help
		enable e logging

config E_LOG_RTT_ENABLE
	bool "enable e logging"
	default n
	depends on E_LOG_ENABLE
	help
		enable e logging

config E_LOG_RTT_TX_BUFFER_SIZE
	int "enable e logging"
	depends on E_LOG_RTT_ENABLE
	default 2048
	help
		enable e logging

config E_ACTIVITY_STACK_DEPTH
	int "Total depth of the activity stack"
	default 16
	help
		Total depth of the activity stack

config E_MSG_HEADER_1
	hex "Header byte 1"
	default 0xBE
	help
		Header byte 1

config E_MSG_HEADER_2
	hex "Header byte 2"
	default 0xEF
	help
		Header byte 2
        
config E_MSG_HEADER_3
	hex "Header byte 3"
	default 0xAA
	help
		Header byte 3

config E_MSG_HEADER_4
	hex "Header byte 4"
	default 0x55
	help
		Header byte 4
endmenu
```

## test/zephyr/tick/build/Kconfig/Kconfig.shield
```kconfig
osource "C:/ELI/projects/playpower/crickets/firmware/CricketNode/boards/shields/*/Kconfig.shield"
osource "C:/ELI/projects/playpower/crickets/firmware/monkey-boot/boards/shields/*/Kconfig.shield"
```

## test/zephyr/tick/build/Kconfig/Kconfig.shield.defconfig
```kconfig
osource "C:/ELI/projects/playpower/crickets/firmware/CricketNode/boards/shields/*/Kconfig.defconfig"
osource "C:/ELI/projects/playpower/crickets/firmware/monkey-boot/boards/shields/*/Kconfig.defconfig"
```

## test/zephyr/tick/build/Kconfig/arch/Kconfig
```kconfig
# Load Zephyr Arch Kconfig descriptions.
osource "C:/ELI/projects/playpower/crickets/firmware/zephyr/arch/x86/Kconfig"
osource "C:/ELI/projects/playpower/crickets/firmware/zephyr/arch/xtensa/Kconfig"
osource "C:/ELI/projects/playpower/crickets/firmware/zephyr/arch/sparc/Kconfig"
osource "C:/ELI/projects/playpower/crickets/firmware/zephyr/arch/riscv/Kconfig"
osource "C:/ELI/projects/playpower/crickets/firmware/zephyr/arch/posix/Kconfig"
osource "C:/ELI/projects/playpower/crickets/firmware/zephyr/arch/nios2/Kconfig"
osource "C:/ELI/projects/playpower/crickets/firmware/zephyr/arch/mips/Kconfig"
osource "C:/ELI/projects/playpower/crickets/firmware/zephyr/arch/arm64/Kconfig"
osource "C:/ELI/projects/playpower/crickets/firmware/zephyr/arch/arm/Kconfig"
osource "C:/ELI/projects/playpower/crickets/firmware/zephyr/arch/arc/Kconfig"
```

## test/zephyr/tick/build/Kconfig/boards/Kconfig
```kconfig
# Load Zephyr board Kconfig descriptions.
osource "C:/ELI/projects/playpower/crickets/firmware/zephyr/boards/nxp/frdm_mcxn947/Kconfig"
```

## test/zephyr/tick/build/Kconfig/boards/Kconfig.defconfig
```kconfig
# Load Zephyr board defconfig descriptions.
osource "C:/ELI/projects/playpower/crickets/firmware/zephyr/boards/nxp/frdm_mcxn947/Kconfig.defconfig"
```

## test/zephyr/tick/build/Kconfig/soc/Kconfig
```kconfig
# Load Zephyr SoC Kconfig descriptions.
osource "C:/ELI/projects/playpower/crickets/firmware/zephyr/soc/xlnx/zynqmp/Kconfig"
osource "C:/ELI/projects/playpower/crickets/firmware/zephyr/soc/xlnx/zynq7000/Kconfig"
osource "C:/ELI/projects/playpower/crickets/firmware/zephyr/soc/xen/Kconfig"
osource "C:/ELI/projects/playpower/crickets/firmware/zephyr/soc/wch/ch32v/Kconfig"
osource "C:/ELI/projects/playpower/crickets/firmware/zephyr/soc/ti/simplelink/Kconfig"
osource "C:/ELI/projects/playpower/crickets/firmware/zephyr/soc/ti/lm3s6965/Kconfig"
osource "C:/ELI/projects/playpower/crickets/firmware/zephyr/soc/ti/k3/Kconfig"
osource "C:/ELI/projects/playpower/crickets/firmware/zephyr/soc/telink/tlsr/Kconfig"
osource "C:/ELI/projects/playpower/crickets/firmware/zephyr/soc/starfive/jh71xx/Kconfig"
osource "C:/ELI/projects/playpower/crickets/firmware/zephyr/soc/st/stm32/Kconfig"
osource "C:/ELI/projects/playpower/crickets/firmware/zephyr/soc/snps/qemu_arc/Kconfig"
osource "C:/ELI/projects/playpower/crickets/firmware/zephyr/soc/snps/nsim/arc_v/Kconfig"
osource "C:/ELI/projects/playpower/crickets/firmware/zephyr/soc/snps/nsim/arc_classic/Kconfig"
osource "C:/ELI/projects/playpower/crickets/firmware/zephyr/soc/snps/hsdk4xd/Kconfig"
osource "C:/ELI/projects/playpower/crickets/firmware/zephyr/soc/snps/hsdk/Kconfig"
osource "C:/ELI/projects/playpower/crickets/firmware/zephyr/soc/snps/emsk/Kconfig"
osource "C:/ELI/projects/playpower/crickets/firmware/zephyr/soc/snps/emsdp/Kconfig"
osource "C:/ELI/projects/playpower/crickets/firmware/zephyr/soc/snps/arc_iot/Kconfig"
osource "C:/ELI/projects/playpower/crickets/firmware/zephyr/soc/silabs/Kconfig"
osource "C:/ELI/projects/playpower/crickets/firmware/zephyr/soc/sifive/sifive_freedom/Kconfig"
osource "C:/ELI/projects/playpower/crickets/firmware/zephyr/soc/sensry/Kconfig"
osource "C:/ELI/projects/playpower/crickets/firmware/zephyr/soc/rockchip/Kconfig"
osource "C:/ELI/projects/playpower/crickets/firmware/zephyr/soc/renode/riscv_virtual/Kconfig"
osource "C:/ELI/projects/playpower/crickets/firmware/zephyr/soc/renode/cortex_r8_virtual/Kconfig"
osource "C:/ELI/projects/playpower/crickets/firmware/zephyr/soc/renesas/smartbond/Kconfig"
osource "C:/ELI/projects/playpower/crickets/firmware/zephyr/soc/renesas/rzt2m/Kconfig"
osource "C:/ELI/projects/playpower/crickets/firmware/zephyr/soc/renesas/rz/Kconfig"
osource "C:/ELI/projects/playpower/crickets/firmware/zephyr/soc/renesas/rcar/Kconfig"
osource "C:/ELI/projects/playpower/crickets/firmware/zephyr/soc/renesas/ra/Kconfig"
osource "C:/ELI/projects/playpower/crickets/firmware/zephyr/soc/realtek/ec/Kconfig"
osource "C:/ELI/projects/playpower/crickets/firmware/zephyr/soc/raspberrypi/rpi_pico/Kconfig"
osource "C:/ELI/projects/playpower/crickets/firmware/zephyr/soc/quicklogic/eos_s3/Kconfig"
osource "C:/ELI/projects/playpower/crickets/firmware/zephyr/soc/qemu/virt_riscv/Kconfig"
osource "C:/ELI/projects/playpower/crickets/firmware/zephyr/soc/qemu/malta/Kconfig"
osource "C:/ELI/projects/playpower/crickets/firmware/zephyr/soc/openisa/rv32m1/Kconfig"
osource "C:/ELI/projects/playpower/crickets/firmware/zephyr/soc/nxp/s32/Kconfig"
osource "C:/ELI/projects/playpower/crickets/firmware/zephyr/soc/nxp/rw/Kconfig"
osource "C:/ELI/projects/playpower/crickets/firmware/zephyr/soc/nxp/mcx/Kconfig"
osource "C:/ELI/projects/playpower/crickets/firmware/zephyr/soc/nxp/lpc/Kconfig"
osource "C:/ELI/projects/playpower/crickets/firmware/zephyr/soc/nxp/layerscape/Kconfig"
osource "C:/ELI/projects/playpower/crickets/firmware/zephyr/soc/nxp/kinetis/Kconfig"
osource "C:/ELI/projects/playpower/crickets/firmware/zephyr/soc/nxp/imxrt/Kconfig"
osource "C:/ELI/projects/playpower/crickets/firmware/zephyr/soc/nxp/imx/Kconfig"
osource "C:/ELI/projects/playpower/crickets/firmware/zephyr/soc/nuvoton/numicro/Kconfig"
osource "C:/ELI/projects/playpower/crickets/firmware/zephyr/soc/nuvoton/numaker/Kconfig"
osource "C:/ELI/projects/playpower/crickets/firmware/zephyr/soc/nuvoton/npcx/Kconfig"
osource "C:/ELI/projects/playpower/crickets/firmware/zephyr/soc/nuvoton/npcm/Kconfig"
osource "C:/ELI/projects/playpower/crickets/firmware/zephyr/soc/nordic/Kconfig"
osource "C:/ELI/projects/playpower/crickets/firmware/zephyr/soc/neorv32/Kconfig"
osource "C:/ELI/projects/playpower/crickets/firmware/zephyr/soc/native/inf_clock/Kconfig"
osource "C:/ELI/projects/playpower/crickets/firmware/zephyr/soc/microchip/miv/Kconfig"
osource "C:/ELI/projects/playpower/crickets/firmware/zephyr/soc/microchip/mec/Kconfig"
osource "C:/ELI/projects/playpower/crickets/firmware/zephyr/soc/mediatek/mt8xxx/Kconfig"
osource "C:/ELI/projects/playpower/crickets/firmware/zephyr/soc/lowrisc/opentitan/Kconfig"
osource "C:/ELI/projects/playpower/crickets/firmware/zephyr/soc/litex/litex_vexriscv/Kconfig"
osource "C:/ELI/projects/playpower/crickets/firmware/zephyr/soc/ite/ec/Kconfig"
osource "C:/ELI/projects/playpower/crickets/firmware/zephyr/soc/intel/raptor_lake/Kconfig"
osource "C:/ELI/projects/playpower/crickets/firmware/zephyr/soc/intel/lakemont/Kconfig"
osource "C:/ELI/projects/playpower/crickets/firmware/zephyr/soc/intel/intel_socfpga_std/Kconfig"
osource "C:/ELI/projects/playpower/crickets/firmware/zephyr/soc/intel/intel_socfpga/Kconfig"
osource "C:/ELI/projects/playpower/crickets/firmware/zephyr/soc/intel/intel_niosv/Kconfig"
osource "C:/ELI/projects/playpower/crickets/firmware/zephyr/soc/intel/intel_ish/Kconfig"
osource "C:/ELI/projects/playpower/crickets/firmware/zephyr/soc/intel/intel_adsp/Kconfig"
osource "C:/ELI/projects/playpower/crickets/firmware/zephyr/soc/intel/elkhart_lake/Kconfig"
osource "C:/ELI/projects/playpower/crickets/firmware/zephyr/soc/intel/atom/Kconfig"
osource "C:/ELI/projects/playpower/crickets/firmware/zephyr/soc/intel/apollo_lake/Kconfig"
osource "C:/ELI/projects/playpower/crickets/firmware/zephyr/soc/intel/alder_lake/Kconfig"
osource "C:/ELI/projects/playpower/crickets/firmware/zephyr/soc/infineon/cat3/Kconfig"
osource "C:/ELI/projects/playpower/crickets/firmware/zephyr/soc/infineon/cat1b/Kconfig"
osource "C:/ELI/projects/playpower/crickets/firmware/zephyr/soc/infineon/cat1a/Kconfig"
osource "C:/ELI/projects/playpower/crickets/firmware/zephyr/soc/gd/gd32/Kconfig"
osource "C:/ELI/projects/playpower/crickets/firmware/zephyr/soc/gaisler/leon3/Kconfig"
osource "C:/ELI/projects/playpower/crickets/firmware/zephyr/soc/gaisler/gr716a/Kconfig"
osource "C:/ELI/projects/playpower/crickets/firmware/zephyr/soc/espressif/Kconfig"
osource "C:/ELI/projects/playpower/crickets/firmware/zephyr/soc/ene/kb1200/Kconfig"
osource "C:/ELI/projects/playpower/crickets/firmware/zephyr/soc/efinix/sapphire/Kconfig"
osource "C:/ELI/projects/playpower/crickets/firmware/zephyr/soc/cdns/xtensa_sample_controller/Kconfig"
osource "C:/ELI/projects/playpower/crickets/firmware/zephyr/soc/cdns/sample_controller32/Kconfig"
osource "C:/ELI/projects/playpower/crickets/firmware/zephyr/soc/cdns/dc233c/Kconfig"
osource "C:/ELI/projects/playpower/crickets/firmware/zephyr/soc/brcm/bcmvk/Kconfig"
osource "C:/ELI/projects/playpower/crickets/firmware/zephyr/soc/brcm/bcm2712/Kconfig"
osource "C:/ELI/projects/playpower/crickets/firmware/zephyr/soc/brcm/bcm2711/Kconfig"
osource "C:/ELI/projects/playpower/crickets/firmware/zephyr/soc/atmel/sam0/Kconfig"
osource "C:/ELI/projects/playpower/crickets/firmware/zephyr/soc/atmel/sam/Kconfig"
osource "C:/ELI/projects/playpower/crickets/firmware/zephyr/soc/aspeed/Kconfig"
osource "C:/ELI/projects/playpower/crickets/firmware/zephyr/soc/arm/Kconfig"
osource "C:/ELI/projects/playpower/crickets/firmware/zephyr/soc/arm/beetle/Kconfig"
osource "C:/ELI/projects/playpower/crickets/firmware/zephyr/soc/antmicro/myra/Kconfig"
osource "C:/ELI/projects/playpower/crickets/firmware/zephyr/soc/andestech/Kconfig"
osource "C:/ELI/projects/playpower/crickets/firmware/zephyr/soc/amd/acp_6_0/Kconfig"
osource "C:/ELI/projects/playpower/crickets/firmware/zephyr/soc/ambiq/Kconfig"
osource "C:/ELI/projects/playpower/crickets/firmware/zephyr/soc/altr/zephyr_nios2f/Kconfig"
osource "C:/ELI/projects/playpower/crickets/firmware/zephyr/soc/altr/qemu_nios2/Kconfig"
osource "C:/ELI/projects/playpower/crickets/firmware/zephyr/soc/adi/max32/Kconfig"
```
